## arch/arm/mach-s5l8930/Kconfig
```kconfig
if ARCH_S5L8930

choice
	prompt "S5L8930 board select"
	optional

config TARGET_IPHONE_4
	bool "Support Apple iPhone 4"
	select OF_CONTROL

endchoice

config SYS_SOC
	default "s5l8930"

source "board/apple/iphone4/Kconfig"

endif
```

## board/apple/iphone4/Kconfig
```kconfig
if TARGET_IPHONE_4

config SYS_BOARD
  default "iphone4"

config SYS_VENDOR
  default "apple"

config SYS_CONFIG_NAME
  default "iphone4"

endif
```

## configs/iphone4_defconfig
```kconfig
CONFIG_ARM=y
CONFIG_ARCH_S5L8930=y
CONFIG_TARGET_IPHONE_4=y
CONFIG_DM=y
CONFIG_S5L_UART=y
CONFIG_SYS_TEXT_BASE=0x40004000
CONFIG_NR_DRAM_BANKS=1
CONFIG_DEFAULT_DEVICE_TREE="iphone4"
CONFIG_VIDEO=y
CONFIG_CFB_CONSOLE=y
CONFIG_CFB_CONSOLE_ANSI=y
CONFIG_SYS_CONSOLE_IS_IN_ENV=y
CONFIG_VGA_AS_SINGLE_DEVICE=y
CONFIG_CONSOLE_MUX=y
CONFIG_VIDEO_SW_CURSOR=y
CONFIG_MISC_INIT_R=y
```
